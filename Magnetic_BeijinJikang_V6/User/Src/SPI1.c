/***************************************************************************************
                    This file is the TDC drive C source file

                Edited by xie_yuyin 2018-04-02 for stm32f072 base version
***************************************************************************************/
//Incude files
#include    "spi1.h"

//Macro define

//Functiosnn implement
/***************************************************************************************
Name:  
Func:   
Para:   val is the edge serial no, 1:the first; 2:the second
Retn:
***************************************************************************************/
void SPI_Spi1SwitchCPHA( u8 val )
{
    //Disable spi1
    SPI1->CR1 &= (u16) ~((u16)SPI_CR1_SPE);
    
    if (val == CPHA_FIRST_EDGE)
    {
        SPI1->CR1 &= 0xFFFE;
    }
    else if (val == CPHA_SECOND_EDGE)
    {
        SPI1->CR1 |= 0x0001;
    }
    
    //Enable spi1
    SPI1->CR1 |= SPI_CR1_SPE;
}

/***************************************************************************************
Name:    
Func:   
Para:   
Retn:   
***************************************************************************************/
void SPI_Spi1DriveInite( void )
{
    SPI_InitTypeDef  SPI_InitS;
    GPIO_InitTypeDef GPIO_InitS;
    
    RCC_APB2PeriphClockCmd(RCC_APB2Periph_SPI1,ENABLE);
    RCC_AHBPeriphClockCmd(RCC_AHBPeriph_GPIOB,ENABLE);
    
    GPIO_PinAFConfig(GPIOB, GPIO_PinSource3, GPIO_AF_0);    //SPI1_SCK
    GPIO_PinAFConfig(GPIOB, GPIO_PinSource4, GPIO_AF_0);    //SPI1_MISO
    GPIO_PinAFConfig(GPIOB, GPIO_PinSource5, GPIO_AF_0);    //SPI1_MOSI
    
    GPIO_InitS.GPIO_Pin = GPIO_Pin_3 | GPIO_Pin_4 | GPIO_Pin_5;
    GPIO_InitS.GPIO_Mode = GPIO_Mode_AF;
    GPIO_InitS.GPIO_Speed = GPIO_Speed_50MHz;
    GPIO_InitS.GPIO_OType = GPIO_OType_PP;
    GPIO_InitS.GPIO_PuPd = GPIO_PuPd_NOPULL;
    GPIO_Init(GPIOB, &GPIO_InitS);
    
    SPI_InitS.SPI_Direction = SPI_Direction_2Lines_FullDuplex; 
    SPI_InitS.SPI_Mode = SPI_Mode_Master;	
    SPI_InitS.SPI_DataSize = SPI_DataSize_8b;
    SPI_InitS.SPI_CPOL = SPI_CPOL_Low;    
    SPI_InitS.SPI_CPHA = SPI_CPHA_2Edge;  	
    SPI_InitS.SPI_NSS = SPI_NSS_Soft;	
    SPI_InitS.SPI_BaudRatePrescaler = SPI_BaudRatePrescaler_32;
    SPI_InitS.SPI_FirstBit = SPI_FirstBit_MSB;
    SPI_InitS.SPI_CRCPolynomial = 7;
    SPI_Init(SPI1, &SPI_InitS);

    SPI_RxFIFOThresholdConfig(SPI1, SPI_RxFIFOThreshold_QF);
    SPI_Cmd(SPI1, ENABLE);
}


/***************************************************************************************
Name:    
Func:   
Para:   
Retn:   
***************************************************************************************/
bool SPI_Spi1ReadWrit1Byte( u8* val, u8 para )
{
    u8 i;
    bool ret = false;
    
    do{
        __disable_irq();    //Disable main interrupt switcher
        i = 0;
        while(SPI_I2S_GetFlagStatus(SPI1, SPI_I2S_FLAG_TXE) == RESET) 
        {
            i++;
            if (i > 200) 
                break;
        }
        SPI_SendData8(SPI1, para);
        
        i=0;
        while(SPI_I2S_GetFlagStatus(SPI1, SPI_I2S_FLAG_RXNE) == RESET) 
        {
            i++;
            if (i > 200)
                break;  
        }
        __enable_irq( );    //Enable main interrupt switcher
        
        *val = SPI_ReceiveData8(SPI1);
        ret = true;
    }while (0);
    
    return ret;
}



/***************************************************************************************
Name:    
Func:   
Para:   
Retn:   
***************************************************************************************/

    

/***************************************************************************************
Name:    
Func:   
Para:   
Retn:   
***************************************************************************************/

/***************************************************************************************
Name:    
Func:   
Para:   
Retn:   
***************************************************************************************/

/***************************************************************************************
Name:    
Func:   
Para:   
Retn:   
***************************************************************************************/

/***************************************************************************************
Name:    
Func:   
Para:   
Retn:   
***************************************************************************************/

/***************************************************************************************
Name:    
Func:   
Para:   
Retn:   
***************************************************************************************/


/***************************************************************************************
Name:    
Func:   
Para:   
Retn:   
***************************************************************************************/

/***************************************************************************************
Name:    
Func:   
Para:   
Retn:   
***************************************************************************************/

/***************************************************************************************
Name:    
Func:   
Para:   
Retn:   
***************************************************************************************/

/***************************************************************************************
Name:    
Func:   
Para:   
Retn:   
***************************************************************************************/

/***************************************************************************************
Name:    
Func:   
Para:   
Retn:   
***************************************************************************************/

/***************************************************************************************
Name:    
Func:   
Para:   
Retn:   
***************************************************************************************/


/***************************************************************************************
Name:    
Func:   
Para:   
Retn:   
***************************************************************************************/

/***************************************************************************************
Name:    
Func:   
Para:   
Retn:   
***************************************************************************************/

/***************************************************************************************
Name:    
Func:   
Para:   
Retn:   
***************************************************************************************/

/***************************************************************************************
Name:    
Func:   
Para:   
Retn:   
***************************************************************************************/

/***************************************************************************************
Name:    
Func:   
Para:   
Retn:   
***************************************************************************************/

/***************************************************************************************
Name:    
Func:   
Para:   
Retn:   
***************************************************************************************/
